## config/west.yml
```yaml
manifest:
  remotes:
    - name: medoix
      url-base: https://github.com/medoix
  projects:
    - name: zmk
      remote: medoix
      revision: mikoto_7_1_0
      import: app/west.yml
  self:
    path: config
```
